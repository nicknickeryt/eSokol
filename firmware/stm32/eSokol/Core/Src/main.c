/* USER CODE BEGIN Header */
/**
 ******************************************************************************
 * @file           : main.c
 * @brief          : Main program body
 ******************************************************************************
 * @attention
 *
 * Copyright (c) 2024 STMicroelectronics.
 * All rights reserved.
 *
 * This software is licensed under terms that can be found in the LICENSE file
 * in the root directory of this software component.
 * If no LICENSE file comes with this software, it is provided AS-IS.
 *
 ******************************************************************************
 */
/* USER CODE END Header */
/* Includes ------------------------------------------------------------------*/
#include "main.h"

/* Private includes ----------------------------------------------------------*/
/* USER CODE BEGIN Includes */
#include "ssd1306.h"
#include "ssd1306_fonts.h"
#include "ds3231_for_stm32_hal.h"
#include "stdio.h"
#include "stdbool.h"
/* USER CODE END Includes */

/* Private typedef -----------------------------------------------------------*/
/* USER CODE BEGIN PTD */
const unsigned char logo_romet128_inv[] = { 0x00, 0x00, 0x00, 0x00, 0x00, 0x00,
		0x00, 0x00, 0x00, 0x00, 0x00, 0x00, 0x00, 0x00, 0x00, 0x00, 0x00, 0x00,
		0x00, 0x00, 0x00, 0x00, 0x00, 0x03, 0xFF, 0xFF, 0xFF, 0xFF, 0x00, 0x00,
		0x00, 0x00, 0x00, 0x00, 0x00, 0x00, 0x00, 0x00, 0x00, 0x07, 0xFF, 0xFF,
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		0x00, 0x00 };

const unsigned char swiatla[] = { 0x00, 0x00, 0x00, 0x00, 0x00, 0x00, 0x01,
		0xF0, 0x39, 0x0C, 0xC2, 0x06, 0x02, 0x03, 0x7A, 0x01, 0x82, 0x01, 0x3A,
		0x03, 0xC2, 0x06, 0x19, 0x1C, 0xE1, 0xF0, 0x00, 0x00, 0x00, 0x00, 0x00,
		0x00 };

const unsigned char muted [] = {
		0x80, 0x00, 0x40, 0x00, 0x01, 0x80, 0x03, 0x0C, 0x02, 0x84, 0x38, 0x86, 0x20, 0x92, 0x00, 0x12,
		0x00, 0x12, 0x20, 0x92, 0x34, 0x86, 0x02, 0x84, 0x03, 0x08, 0x01, 0x80, 0x00, 0x02, 0x00, 0x01
};

/* USER CODE END PTD */

/* Private define ------------------------------------------------------------*/
/* USER CODE BEGIN PD */

/* USER CODE END PD */

/* Private macro -------------------------------------------------------------*/
/* USER CODE BEGIN PM */

/* USER CODE END PM */

/* Private variables ---------------------------------------------------------*/
ADC_HandleTypeDef hadc1;

I2C_HandleTypeDef hi2c1;
I2C_HandleTypeDef hi2c2;

TIM_HandleTypeDef htim1;
TIM_HandleTypeDef htim2;
TIM_HandleTypeDef htim3;

/* USER CODE BEGIN PV */

/* USER CODE END PV */

/* Private function prototypes -----------------------------------------------*/
void SystemClock_Config(void);
static void MX_GPIO_Init(void);
static void MX_I2C2_Init(void);
static void MX_TIM1_Init(void);
static void MX_TIM2_Init(void);
static void MX_TIM3_Init(void);
static void MX_I2C1_Init(void);
static void MX_ADC1_Init(void);
/* USER CODE BEGIN PFP */

/* USER CODE END PFP */

/* Private user code ---------------------------------------------------------*/
/* USER CODE BEGIN 0 */

/*
 * -1 nothing
 * 0 main menu
 * 1 settings
 * 2 lightsmenu
 */
int currPage = -1;

int nextPage = -1;

/*
 * -1 nothing
 * 0 toggle headlights
 * 1 toggle sound
 * 2 toggle headlight animation
 *
 */
int nextAction = -1;

/*
 * 0..4 - current menu selection no.
 */
uint8_t nextSel = 0;

uint8_t encPos = 0;
uint8_t encCurPos = 0;

// SETTINGS
bool headlights = false;

volatile uint8_t pulse_count = 0;
uint32_t timeMs = 0;

bool sound = true;

bool anim = true;

int animTimeMs;

int beepTime;

int adcMs;

bool isHeaderEnabled = true;

int timeUpdInt = 1000;

int timeUpdTime;


// batt sense
uint8_t nth_raw = 0;
uint16_t raw[10] = {0};
float voltage = 0;


void stopBeep(){
	 HAL_TIM_PWM_Stop(&htim2, TIM_CHANNEL_2);
}

void beep(int tone) {
	if (!sound)
		return;

	beepTime = HAL_GetTick();
	HAL_TIM_PWM_Start(&htim2, TIM_CHANNEL_2);

	switch (tone) {
	case 0:
		__HAL_TIM_SET_AUTORELOAD(&htim2, 30);
		__HAL_TIM_SET_COMPARE(&htim2, TIM_CHANNEL_2, 15);
		break;
	case 1:
		__HAL_TIM_SET_AUTORELOAD(&htim2, 45);
		__HAL_TIM_SET_COMPARE(&htim2, TIM_CHANNEL_2, 22);
		break;
	case 2:
		__HAL_TIM_SET_AUTORELOAD(&htim2, 50);
		__HAL_TIM_SET_COMPARE(&htim2, TIM_CHANNEL_2, 25);
		break;
	}
}



void formatTime(uint8_t hour, uint8_t minute, char *output) {
    // Sprawdzenie czy godzina jest jednocyfrowa
    if (hour < 10) {
        // Jeśli godzina jest jednocyfrowa, dodaj '0' przed nią
        sprintf(output, "0%d:", hour);
    } else {
        // W przeciwnym razie, zapisz godzinę normalnie
        sprintf(output, "%d:", hour);
    }

    // Sprawdzenie czy minuta jest jednocyfrowa
    if (minute < 10) {
        // Jeśli minuta jest jednocyfrowa, dodaj '0' przed nią
        sprintf(output + 3, "0%d", minute); // +3 bo wtedy zaczynamy od trzeciego znaku
    } else {
        // W przeciwnym razie, zapisz minutę normalnie
        sprintf(output + 3, "%d", minute); // +3 bo wtedy zaczynamy od trzeciego znaku
    }
}

void splitFloat(float num, int *beforeDecimal, int *afterDecimal) {
	*beforeDecimal = (int) num; // Część całkowita
	*afterDecimal = (int) ((num - *beforeDecimal) * 100); // Część ułamkowa
}

void addHeader() {
	if(!isHeaderEnabled) return;


	for (int i=0; i<10; i++) {
		voltage = voltage +  (2 * 3.3 * ((float)raw[i]/4095));
	}
	voltage = voltage/10;


	uint8_t hour = DS3231_GetHour();
	uint8_t minute = DS3231_GetMinute();

	ssd1306_SetCursor(0, 0);
	ssd1306_WriteString("ROMET", Font_6x8, White);

	ssd1306_SetCursor(51, 0);

	char buf[5];
	formatTime(hour, minute, buf);


	ssd1306_WriteString(buf, Font_6x8, White);

	// bottom line
	ssd1306_Line(0, 9, 128, 9, White);

	int beforeDecimal = 0;
	int afterDecimal = 0;
	splitFloat(voltage, &beforeDecimal, &afterDecimal);

	char buf1[2];
	sprintf(buf1,"%d", beforeDecimal);

	char buf2[4];
	sprintf(buf2,"%d", afterDecimal);


	ssd1306_SetCursor(101, 0);
	ssd1306_WriteString(buf1, Font_6x8, White);
	ssd1306_SetCursor(106, 0);
	ssd1306_WriteString(".", Font_6x8, White);
	ssd1306_SetCursor(111, 0);
	ssd1306_WriteString(buf2, Font_6x8, White);

}

void showSettingsPage(int page, int sel, bool blink) {
	beep(1);
	currPage = page;
	int offset = 13;
	ssd1306_Fill(Black);
	addHeader();
	ssd1306_SetCursor(5, offset);

	int y = 21 + offset + sel * 15;
	int y1 = 36 + offset + sel * 15;

	SSD1306_COLOR colors[5] = { 1, 1, 1, 1, 1 };

	if (!blink)
		colors[sel] = 0;

	switch (page) {
	case 1:
		ssd1306_WriteString("Ustawienia", Font_11x18, White);

		ssd1306_Line(0, 21 + offset, 128, 21 + offset, White);

		ssd1306_SetCursor(5, 25 + offset);

		ssd1306_FillRectangle(0, y, 128, y1, !blink);
		ssd1306_WriteString("Swiatla", Font_7x10, colors[0]);
		ssd1306_Line(0, 36 + offset, 128, 36 + offset, White);

		ssd1306_SetCursor(5, 38 + offset);

		ssd1306_WriteString("Hamulce", Font_7x10, colors[1]);
		ssd1306_Line(0, 51 + offset, 128, 51 + offset, White);

		ssd1306_SetCursor(5, 53 + offset);

		ssd1306_WriteString("Dzwiek", Font_7x10, colors[2]);
		ssd1306_Line(0, 66 + offset, 128, 66 + offset, White);

		ssd1306_SetCursor(5, 120);

		ssd1306_WriteString("OK", Font_6x8, White);

		ssd1306_SetCursor(87, 120);
		ssd1306_WriteString("Wstecz", Font_6x8, White);
		break;
	case 2:
		ssd1306_WriteString("Swiatla", Font_11x18, White);

		ssd1306_Line(0, 21 + offset, 128, 21 + offset, White);

		ssd1306_SetCursor(5, 25 + offset);

		ssd1306_FillRectangle(0, y, 128, y1, !blink);
		ssd1306_WriteString("Wlacz/wylacz", Font_7x10, colors[0]);
		ssd1306_Line(0, 36 + offset, 128, 36 + offset, White);

		ssd1306_SetCursor(5, 38 + offset);

		ssd1306_WriteString("Animacje", Font_7x10, colors[1]);
		ssd1306_Line(0, 51 + offset, 128, 51 + offset, White);

		ssd1306_SetCursor(5, 120);

		ssd1306_WriteString("OK", Font_6x8, White);

		ssd1306_SetCursor(87, 120);
		ssd1306_WriteString("Wstecz", Font_6x8, White);
		break;
	}
	ssd1306_UpdateScreen();
}

void addHomeIcons() {
	if (headlights) ssd1306_DrawBitmap(5, 15, swiatla, 16, 16, White);
	if (!sound) 	ssd1306_DrawBitmap(26, 15, muted, 16, 16, White);
}

void showHomescreen(int splash) {
	currPage = 0;
	ssd1306_Init();

	if (splash) {
		ssd1306_Fill(White);
		ssd1306_UpdateScreen();
		ssd1306_Fill(Black);
		ssd1306_UpdateScreen();

		ssd1306_DrawBitmap(0, 0, logo_romet128_inv, 128, 128, White);
		ssd1306_UpdateScreen();

		HAL_Delay(500);
	}

	ssd1306_Fill(Black);

	ssd1306_SetCursor(30, 50);
	ssd1306_WriteString("12.5", Font_16x26, White);

	ssd1306_SetCursor(50, 78);
	ssd1306_WriteString("km/h", Font_7x10, White);

	ssd1306_SetCursor(5, 120);

	ssd1306_WriteString("Menu", Font_6x8, White);

	ssd1306_SetCursor(80, 120);
	ssd1306_WriteString("Swiatla", Font_6x8, White);

	addHeader();

	addHomeIcons();

	ssd1306_UpdateScreen();

	if(!splash) {
		beep(1);
		HAL_Delay(50);
		stopBeep();
		beep(2);
	}
}

void jumpSel(int button) {

	if (currPage == 0)
		nextPage = button == 0 ? 1 : 2;

	else if (currPage == 1) { // settings
		if (button == 1) {
			nextPage = 0;
			return;
		} else if (button == 0) {
			switch(nextSel) {
				case 0:
					nextPage = 2;
					break;
				case 2:
					nextAction = 1;
					break;
			}
		}


	} else if (currPage == 2) { // lights
		if (button == 1) {
			nextPage = 0;
			return;
		} else if (button == 0) {

			switch(nextSel) {
				case 0:
					nextAction = 0;
					break;
				case 1:
					nextAction = 2;
					break;
			}
		}
	}

}

void HAL_GPIO_EXTI_Callback(uint16_t GPIO_Pin) {
	if (GPIO_Pin == GPIO_PIN_1 && ((HAL_GetTick() - timeMs) > 150)
			&& HAL_GPIO_ReadPin(GPIOB, GPIO_Pin) == 0) // If The INT Source Is EXTI Line9 (A9 Pin)
					{
		jumpSel(0);
		timeMs = HAL_GetTick();
	} else if (GPIO_Pin == GPIO_PIN_0 && ((HAL_GetTick() - timeMs) > 150)
			&& HAL_GPIO_ReadPin(GPIOB, GPIO_Pin) == 0) // If The INT Source Is EXTI Line9 (A9 Pin)
					{
		jumpSel(1);
		timeMs = HAL_GetTick();
	}
}

/* USER CODE END 0 */

/**
  * @brief  The application entry point.
  * @retval int
  */
int main(void)
{

  /* USER CODE BEGIN 1 */
  /* USER CODE END 1 */

  /* MCU Configuration--------------------------------------------------------*/

  /* Reset of all peripherals, Initializes the Flash interface and the Systick. */
  HAL_Init();

  /* USER CODE BEGIN Init */

  /* USER CODE END Init */

  /* Configure the system clock */
  SystemClock_Config();

  /* USER CODE BEGIN SysInit */

  /* USER CODE END SysInit */

  /* Initialize all configured peripherals */
  MX_GPIO_Init();
  MX_I2C2_Init();
  MX_TIM1_Init();
  MX_TIM2_Init();
  MX_TIM3_Init();
  MX_I2C1_Init();
  MX_ADC1_Init();
  /* USER CODE BEGIN 2 */


  	DS3231_Init(&hi2c1);

	HAL_TIM_Encoder_Start(&htim1, TIM_CHANNEL_ALL);

	beep(0);

	showHomescreen(1);

	ssd1306_SetContrast(255);

	beep(1);
	HAL_Delay(25);
	stopBeep();
	HAL_Delay(25);
	beep(1);

	animTimeMs = timeUpdTime = HAL_GetTick();
	adcMs = -5001;


	/*
	 showSettings();

	 HAL_Delay(1500);*/

	bool bylo = 0;
  /* USER CODE END 2 */

  /* Infinite loop */
  /* USER CODE BEGIN WHILE */
	while (1) {
		// periodical voltage check
		if (HAL_GetTick() - adcMs > 800 && !bylo) {
			HAL_GPIO_WritePin(GPIOA, GPIO_PIN_11, GPIO_PIN_SET);
			bylo = 1;
		}
		if( HAL_GetTick() - adcMs > 1000) {
			nth_raw=nth_raw == 10 ? 0 : nth_raw + 1;
			HAL_ADC_Start(&hadc1);
			if(HAL_ADC_PollForConversion(&hadc1, 10) == HAL_OK) {
				raw[nth_raw] = HAL_ADC_GetValue(&hadc1);
			}
			HAL_ADC_Stop(&hadc1);
			adcMs=HAL_GetTick();
			//HAL_GPIO_WritePin(GPIOA, GPIO_PIN_11, GPIO_PIN_RESET);
			bylo=0;
		}



		if(HAL_GetTick() - beepTime > 50 ) stopBeep();

		if(HAL_GetTick() - timeUpdTime > timeUpdInt ) {
			addHeader();
			ssd1306_UpdateScreen();
		}


		encCurPos = TIM1->CNT;
		if ((encCurPos != encPos) && (currPage != 0)) {
			nextSel = encCurPos % 5;
			showSettingsPage(currPage, nextSel, 0);
			encPos = encCurPos;
		}

		if (nextPage != -1) {
			switch (nextPage) {
			case 0:
				showHomescreen(0);
				TIM1->CNT = nextSel = encCurPos = encPos = 0;
				break;
			case 1:
				showSettingsPage(nextPage, nextSel, 0);
				break;
			case 2:
				showSettingsPage(nextPage, nextSel, 0);
				break;
			}
			nextPage = -1;
		}

		if (nextAction != -1) {
			switch (nextAction) {
			case 0:
				if (headlights) {
					headlights = false;
					HAL_TIM_PWM_Stop(&htim3, TIM_CHANNEL_1);
				} else {
					headlights = true;
					HAL_TIM_PWM_Start(&htim3, TIM_CHANNEL_1);
					htim3.Instance->CCR1 = 255;
				}
				showSettingsPage(currPage, nextSel, 1);
				showSettingsPage(currPage, nextSel, 0);
				break;

			case 1:
				showSettingsPage(currPage, nextSel, 1);
				showSettingsPage(currPage, nextSel, 0);
				sound = sound == true ? false: true;
				break;
			case 2:
				showSettingsPage(currPage, nextSel, 1);
				showSettingsPage(currPage, nextSel, 0);
				anim = anim == true ? false: true;
				htim3.Instance->CCR1 = 255;
				break;
			}
			nextAction = -1;
		}

		// todo zmienic na switch zeby bylo szybciej
		if(headlights && anim) {
			if(HAL_GetTick() - animTimeMs > 1200) {
				htim3.Instance->CCR1 = 255;
				animTimeMs = HAL_GetTick();
			}
			else if(HAL_GetTick() - animTimeMs > 1100) {
				htim3.Instance->CCR1 = 220;
			}
			else if(HAL_GetTick() - animTimeMs > 1000) {
				htim3.Instance->CCR1 = 200;
			}
			else if(HAL_GetTick() - animTimeMs > 900) {
				htim3.Instance->CCR1 = 180;
			}
			else if(HAL_GetTick() - animTimeMs > 800) {
				htim3.Instance->CCR1 = 160;
			}
			else if(HAL_GetTick() - animTimeMs > 700) {
				htim3.Instance->CCR1 = 140;
			}
			else if(HAL_GetTick() - animTimeMs > 600) {
				htim3.Instance->CCR1 = 120;
			}
			else if(HAL_GetTick() - animTimeMs > 500) {
				htim3.Instance->CCR1 = 100;
			}
			else if(HAL_GetTick() - animTimeMs > 400) {
				htim3.Instance->CCR1 = 80;
			}
			else if(HAL_GetTick() - animTimeMs > 300) {
				htim3.Instance->CCR1 = 60;
			}
			else if(HAL_GetTick() - animTimeMs > 200) {
				htim3.Instance->CCR1 = 40;
			}
			else if(HAL_GetTick() - animTimeMs > 100) {
				htim3.Instance->CCR1 = 20;
			}
			else {
				htim3.Instance->CCR1 = 0;
			}

		}


    /* USER CODE END WHILE */

    /* USER CODE BEGIN 3 */
	}
  /* USER CODE END 3 */
}

/**
  * @brief System Clock Configuration
  * @retval None
  */
void SystemClock_Config(void)
{
  RCC_OscInitTypeDef RCC_OscInitStruct = {0};
  RCC_ClkInitTypeDef RCC_ClkInitStruct = {0};

  /** Configure the main internal regulator output voltage
  */
  __HAL_RCC_PWR_CLK_ENABLE();
  __HAL_PWR_VOLTAGESCALING_CONFIG(PWR_REGULATOR_VOLTAGE_SCALE2);

  /** Initializes the RCC Oscillators according to the specified parameters
  * in the RCC_OscInitTypeDef structure.
  */
  RCC_OscInitStruct.OscillatorType = RCC_OSCILLATORTYPE_HSI;
  RCC_OscInitStruct.HSIState = RCC_HSI_ON;
  RCC_OscInitStruct.HSICalibrationValue = RCC_HSICALIBRATION_DEFAULT;
  RCC_OscInitStruct.PLL.PLLState = RCC_PLL_ON;
  RCC_OscInitStruct.PLL.PLLSource = RCC_PLLSOURCE_HSI;
  RCC_OscInitStruct.PLL.PLLM = 8;
  RCC_OscInitStruct.PLL.PLLN = 64;
  RCC_OscInitStruct.PLL.PLLP = RCC_PLLP_DIV2;
  RCC_OscInitStruct.PLL.PLLQ = 4;
  if (HAL_RCC_OscConfig(&RCC_OscInitStruct) != HAL_OK)
  {
    Error_Handler();
  }

  /** Initializes the CPU, AHB and APB buses clocks
  */
  RCC_ClkInitStruct.ClockType = RCC_CLOCKTYPE_HCLK|RCC_CLOCKTYPE_SYSCLK
                              |RCC_CLOCKTYPE_PCLK1|RCC_CLOCKTYPE_PCLK2;
  RCC_ClkInitStruct.SYSCLKSource = RCC_SYSCLKSOURCE_PLLCLK;
  RCC_ClkInitStruct.AHBCLKDivider = RCC_SYSCLK_DIV4;
  RCC_ClkInitStruct.APB1CLKDivider = RCC_HCLK_DIV2;
  RCC_ClkInitStruct.APB2CLKDivider = RCC_HCLK_DIV1;

  if (HAL_RCC_ClockConfig(&RCC_ClkInitStruct, FLASH_LATENCY_0) != HAL_OK)
  {
    Error_Handler();
  }
}

/**
  * @brief ADC1 Initialization Function
  * @param None
  * @retval None
  */
static void MX_ADC1_Init(void)
{

  /* USER CODE BEGIN ADC1_Init 0 */

  /* USER CODE END ADC1_Init 0 */

  ADC_ChannelConfTypeDef sConfig = {0};

  /* USER CODE BEGIN ADC1_Init 1 */

  /* USER CODE END ADC1_Init 1 */

  /** Configure the global features of the ADC (Clock, Resolution, Data Alignment and number of conversion)
  */
  hadc1.Instance = ADC1;
  hadc1.Init.ClockPrescaler = ADC_CLOCK_SYNC_PCLK_DIV2;
  hadc1.Init.Resolution = ADC_RESOLUTION_12B;
  hadc1.Init.ScanConvMode = DISABLE;
  hadc1.Init.ContinuousConvMode = ENABLE;
  hadc1.Init.DiscontinuousConvMode = DISABLE;
  hadc1.Init.ExternalTrigConvEdge = ADC_EXTERNALTRIGCONVEDGE_NONE;
  hadc1.Init.ExternalTrigConv = ADC_SOFTWARE_START;
  hadc1.Init.DataAlign = ADC_DATAALIGN_RIGHT;
  hadc1.Init.NbrOfConversion = 1;
  hadc1.Init.DMAContinuousRequests = DISABLE;
  hadc1.Init.EOCSelection = ADC_EOC_SINGLE_CONV;
  if (HAL_ADC_Init(&hadc1) != HAL_OK)
  {
    Error_Handler();
  }

  /** Configure for the selected ADC regular channel its corresponding rank in the sequencer and its sample time.
  */
  sConfig.Channel = ADC_CHANNEL_7;
  sConfig.Rank = 1;
  sConfig.SamplingTime = ADC_SAMPLETIME_3CYCLES;
  if (HAL_ADC_ConfigChannel(&hadc1, &sConfig) != HAL_OK)
  {
    Error_Handler();
  }
  /* USER CODE BEGIN ADC1_Init 2 */

  /* USER CODE END ADC1_Init 2 */

}

/**
  * @brief I2C1 Initialization Function
  * @param None
  * @retval None
  */
static void MX_I2C1_Init(void)
{

  /* USER CODE BEGIN I2C1_Init 0 */

  /* USER CODE END I2C1_Init 0 */

  /* USER CODE BEGIN I2C1_Init 1 */

  /* USER CODE END I2C1_Init 1 */
  hi2c1.Instance = I2C1;
  hi2c1.Init.ClockSpeed = 100000;
  hi2c1.Init.DutyCycle = I2C_DUTYCYCLE_2;
  hi2c1.Init.OwnAddress1 = 0;
  hi2c1.Init.AddressingMode = I2C_ADDRESSINGMODE_7BIT;
  hi2c1.Init.DualAddressMode = I2C_DUALADDRESS_DISABLE;
  hi2c1.Init.OwnAddress2 = 0;
  hi2c1.Init.GeneralCallMode = I2C_GENERALCALL_DISABLE;
  hi2c1.Init.NoStretchMode = I2C_NOSTRETCH_DISABLE;
  if (HAL_I2C_Init(&hi2c1) != HAL_OK)
  {
    Error_Handler();
  }
  /* USER CODE BEGIN I2C1_Init 2 */

  /* USER CODE END I2C1_Init 2 */

}

/**
  * @brief I2C2 Initialization Function
  * @param None
  * @retval None
  */
static void MX_I2C2_Init(void)
{

  /* USER CODE BEGIN I2C2_Init 0 */

  /* USER CODE END I2C2_Init 0 */

  /* USER CODE BEGIN I2C2_Init 1 */

  /* USER CODE END I2C2_Init 1 */
  hi2c2.Instance = I2C2;
  hi2c2.Init.ClockSpeed = 400000;
  hi2c2.Init.DutyCycle = I2C_DUTYCYCLE_16_9;
  hi2c2.Init.OwnAddress1 = 0;
  hi2c2.Init.AddressingMode = I2C_ADDRESSINGMODE_7BIT;
  hi2c2.Init.DualAddressMode = I2C_DUALADDRESS_DISABLE;
  hi2c2.Init.OwnAddress2 = 0;
  hi2c2.Init.GeneralCallMode = I2C_GENERALCALL_DISABLE;
  hi2c2.Init.NoStretchMode = I2C_NOSTRETCH_DISABLE;
  if (HAL_I2C_Init(&hi2c2) != HAL_OK)
  {
    Error_Handler();
  }
  /* USER CODE BEGIN I2C2_Init 2 */

  /* USER CODE END I2C2_Init 2 */

}

/**
  * @brief TIM1 Initialization Function
  * @param None
  * @retval None
  */
static void MX_TIM1_Init(void)
{

  /* USER CODE BEGIN TIM1_Init 0 */

  /* USER CODE END TIM1_Init 0 */

  TIM_Encoder_InitTypeDef sConfig = {0};
  TIM_MasterConfigTypeDef sMasterConfig = {0};

  /* USER CODE BEGIN TIM1_Init 1 */

  /* USER CODE END TIM1_Init 1 */
  htim1.Instance = TIM1;
  htim1.Init.Prescaler = 0;
  htim1.Init.CounterMode = TIM_COUNTERMODE_UP;
  htim1.Init.Period = 16;
  htim1.Init.ClockDivision = TIM_CLOCKDIVISION_DIV1;
  htim1.Init.RepetitionCounter = 0;
  htim1.Init.AutoReloadPreload = TIM_AUTORELOAD_PRELOAD_DISABLE;
  sConfig.EncoderMode = TIM_ENCODERMODE_TI1;
  sConfig.IC1Polarity = TIM_ICPOLARITY_RISING;
  sConfig.IC1Selection = TIM_ICSELECTION_DIRECTTI;
  sConfig.IC1Prescaler = TIM_ICPSC_DIV1;
  sConfig.IC1Filter = 0;
  sConfig.IC2Polarity = TIM_ICPOLARITY_RISING;
  sConfig.IC2Selection = TIM_ICSELECTION_DIRECTTI;
  sConfig.IC2Prescaler = TIM_ICPSC_DIV1;
  sConfig.IC2Filter = 0;
  if (HAL_TIM_Encoder_Init(&htim1, &sConfig) != HAL_OK)
  {
    Error_Handler();
  }
  sMasterConfig.MasterOutputTrigger = TIM_TRGO_RESET;
  sMasterConfig.MasterSlaveMode = TIM_MASTERSLAVEMODE_DISABLE;
  if (HAL_TIMEx_MasterConfigSynchronization(&htim1, &sMasterConfig) != HAL_OK)
  {
    Error_Handler();
  }
  /* USER CODE BEGIN TIM1_Init 2 */

  /* USER CODE END TIM1_Init 2 */

}

/**
  * @brief TIM2 Initialization Function
  * @param None
  * @retval None
  */
static void MX_TIM2_Init(void)
{

  /* USER CODE BEGIN TIM2_Init 0 */

  /* USER CODE END TIM2_Init 0 */

  TIM_ClockConfigTypeDef sClockSourceConfig = {0};
  TIM_MasterConfigTypeDef sMasterConfig = {0};
  TIM_OC_InitTypeDef sConfigOC = {0};

  /* USER CODE BEGIN TIM2_Init 1 */

  /* USER CODE END TIM2_Init 1 */
  htim2.Instance = TIM2;
  htim2.Init.Prescaler = 127;
  htim2.Init.CounterMode = TIM_COUNTERMODE_UP;
  htim2.Init.Period = 20;
  htim2.Init.ClockDivision = TIM_CLOCKDIVISION_DIV1;
  htim2.Init.AutoReloadPreload = TIM_AUTORELOAD_PRELOAD_DISABLE;
  if (HAL_TIM_Base_Init(&htim2) != HAL_OK)
  {
    Error_Handler();
  }
  sClockSourceConfig.ClockSource = TIM_CLOCKSOURCE_INTERNAL;
  if (HAL_TIM_ConfigClockSource(&htim2, &sClockSourceConfig) != HAL_OK)
  {
    Error_Handler();
  }
  if (HAL_TIM_PWM_Init(&htim2) != HAL_OK)
  {
    Error_Handler();
  }
  sMasterConfig.MasterOutputTrigger = TIM_TRGO_RESET;
  sMasterConfig.MasterSlaveMode = TIM_MASTERSLAVEMODE_DISABLE;
  if (HAL_TIMEx_MasterConfigSynchronization(&htim2, &sMasterConfig) != HAL_OK)
  {
    Error_Handler();
  }
  sConfigOC.OCMode = TIM_OCMODE_PWM1;
  sConfigOC.Pulse = 0;
  sConfigOC.OCPolarity = TIM_OCPOLARITY_HIGH;
  sConfigOC.OCFastMode = TIM_OCFAST_DISABLE;
  if (HAL_TIM_PWM_ConfigChannel(&htim2, &sConfigOC, TIM_CHANNEL_2) != HAL_OK)
  {
    Error_Handler();
  }
  /* USER CODE BEGIN TIM2_Init 2 */

  /* USER CODE END TIM2_Init 2 */
  HAL_TIM_MspPostInit(&htim2);

}

/**
  * @brief TIM3 Initialization Function
  * @param None
  * @retval None
  */
static void MX_TIM3_Init(void)
{

  /* USER CODE BEGIN TIM3_Init 0 */

  /* USER CODE END TIM3_Init 0 */

  TIM_ClockConfigTypeDef sClockSourceConfig = {0};
  TIM_MasterConfigTypeDef sMasterConfig = {0};
  TIM_OC_InitTypeDef sConfigOC = {0};

  /* USER CODE BEGIN TIM3_Init 1 */

  /* USER CODE END TIM3_Init 1 */
  htim3.Instance = TIM3;
  htim3.Init.Prescaler = 0;
  htim3.Init.CounterMode = TIM_COUNTERMODE_UP;
  htim3.Init.Period = 255;
  htim3.Init.ClockDivision = TIM_CLOCKDIVISION_DIV1;
  htim3.Init.AutoReloadPreload = TIM_AUTORELOAD_PRELOAD_DISABLE;
  if (HAL_TIM_Base_Init(&htim3) != HAL_OK)
  {
    Error_Handler();
  }
  sClockSourceConfig.ClockSource = TIM_CLOCKSOURCE_INTERNAL;
  if (HAL_TIM_ConfigClockSource(&htim3, &sClockSourceConfig) != HAL_OK)
  {
    Error_Handler();
  }
  if (HAL_TIM_PWM_Init(&htim3) != HAL_OK)
  {
    Error_Handler();
  }
  sMasterConfig.MasterOutputTrigger = TIM_TRGO_RESET;
  sMasterConfig.MasterSlaveMode = TIM_MASTERSLAVEMODE_DISABLE;
  if (HAL_TIMEx_MasterConfigSynchronization(&htim3, &sMasterConfig) != HAL_OK)
  {
    Error_Handler();
  }
  sConfigOC.OCMode = TIM_OCMODE_PWM1;
  sConfigOC.Pulse = 0;
  sConfigOC.OCPolarity = TIM_OCPOLARITY_HIGH;
  sConfigOC.OCFastMode = TIM_OCFAST_DISABLE;
  if (HAL_TIM_PWM_ConfigChannel(&htim3, &sConfigOC, TIM_CHANNEL_1) != HAL_OK)
  {
    Error_Handler();
  }
  /* USER CODE BEGIN TIM3_Init 2 */

  /* USER CODE END TIM3_Init 2 */
  HAL_TIM_MspPostInit(&htim3);

}

/**
  * @brief GPIO Initialization Function
  * @param None
  * @retval None
  */
static void MX_GPIO_Init(void)
{
  GPIO_InitTypeDef GPIO_InitStruct = {0};
/* USER CODE BEGIN MX_GPIO_Init_1 */
/* USER CODE END MX_GPIO_Init_1 */

  /* GPIO Ports Clock Enable */
  __HAL_RCC_GPIOA_CLK_ENABLE();
  __HAL_RCC_GPIOB_CLK_ENABLE();

  /*Configure GPIO pin Output Level */
  HAL_GPIO_WritePin(BATT_SENSE_EN_GPIO_Port, BATT_SENSE_EN_Pin, GPIO_PIN_RESET);

  /*Configure GPIO pins : PB0 PB1 */
  GPIO_InitStruct.Pin = GPIO_PIN_0|GPIO_PIN_1;
  GPIO_InitStruct.Mode = GPIO_MODE_IT_RISING;
  GPIO_InitStruct.Pull = GPIO_PULLUP;
  HAL_GPIO_Init(GPIOB, &GPIO_InitStruct);

  /*Configure GPIO pin : BATT_SENSE_EN_Pin */
  GPIO_InitStruct.Pin = BATT_SENSE_EN_Pin;
  GPIO_InitStruct.Mode = GPIO_MODE_OUTPUT_PP;
  GPIO_InitStruct.Pull = GPIO_NOPULL;
  GPIO_InitStruct.Speed = GPIO_SPEED_FREQ_LOW;
  HAL_GPIO_Init(BATT_SENSE_EN_GPIO_Port, &GPIO_InitStruct);

  /* EXTI interrupt init*/
  HAL_NVIC_SetPriority(EXTI0_IRQn, 0, 0);
  HAL_NVIC_EnableIRQ(EXTI0_IRQn);

  HAL_NVIC_SetPriority(EXTI1_IRQn, 0, 0);
  HAL_NVIC_EnableIRQ(EXTI1_IRQn);

/* USER CODE BEGIN MX_GPIO_Init_2 */
/* USER CODE END MX_GPIO_Init_2 */
}

/* USER CODE BEGIN 4 */

/* USER CODE END 4 */

/**
  * @brief  This function is executed in case of error occurrence.
  * @retval None
  */
void Error_Handler(void)
{
  /* USER CODE BEGIN Error_Handler_Debug */
	/* User can add his own implementation to report the HAL error return state */
	__disable_irq();
	while (1) {
	}
  /* USER CODE END Error_Handler_Debug */
}

#ifdef  USE_FULL_ASSERT
/**
  * @brief  Reports the name of the source file and the source line number
  *         where the assert_param error has occurred.
  * @param  file: pointer to the source file name
  * @param  line: assert_param error line source number
  * @retval None
  */
void assert_failed(uint8_t *file, uint32_t line)
{
  /* USER CODE BEGIN 6 */
  /* User can add his own implementation to report the file name and line number,
     ex: printf("Wrong parameters value: file %s on line %d\r\n", file, line) */
  /* USER CODE END 6 */
}
#endif /* USE_FULL_ASSERT */
